# file: Talma_NodeBoard_Git.ioc
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CAN1.BS1=CAN_BS1_15TQ
CAN1.BS2=CAN_BS2_2TQ
CAN1.CalculateBaudRate=250000
CAN1.CalculateTimeBit=4000
CAN1.CalculateTimeQuantum=222.22222222222223
CAN1.NART=ENABLE
CAN1.Prescaler=12
CORTEX_M7.default_mode_Activation=1
FREERTOS.Tasks01=defaultTask,24,128,StartDefaultTask,Default,NULL,Dynamic,NULL,NULL;v_SensorTask,24,1024,SensorTask,Default,NULL,Static,SensorTaskBuffer,SensorTaskControlBlock;v_CmdTask,32,1024,CmdTask,Default,NULL,Static,v_CmdTaskBuffer,v_CmdTaskControlBlock;v_CanTxTask,32,512,CanTxTask,Default,NULL,Static,v_CanTxTaskBuffer,v_CanTxTaskControlBlock
I2C1.Timing=0x20404768
I2C2.Timing=0x20404768
I2C3.Timing=0x20404768
I2C4.Timing=0x20404768
Mcu.Family=STM32F7
Mcu.Name=STM32F767B(G-I)Tx
Mcu.Package=LQFP208
NVIC.CAN1_RX0_IRQn=true\:5\:0\:false\:false\:true\:true\:true\:true\:true
NVIC.PriorityGroup=NVIC_PRIORITYGROUP_4
NVIC.TIM3_IRQn=true\:5\:0\:false\:false\:true\:true\:true\:true\:true
PA0/WKUP.GPIO_Label=Pix15_PW
PA0/WKUP.PinState=GPIO_PIN_SET
PA0/WKUP.Signal=GPIO_Output
PA1.GPIO_Label=Pix15_Dir
PA1.PinState=GPIO_PIN_RESET
PA1.Signal=GPIO_Output
PA10.GPIO_Label=Pix31_PW
PA10.PinState=GPIO_PIN_SET
PA10.Signal=GPIO_Output
PA11.GPIO_Label=Pix32_Xs
PA11.PinState=GPIO_PIN_SET
PA11.Signal=GPIO_Output
PA12.GPIO_Label=Pix32_En
PA12.PinState=GPIO_PIN_SET
PA12.Signal=GPIO_Output
PA13.Mode=Serial_Wire
PA13.Signal=SYS_JTMS-SWDIO
PA14.Mode=Serial_Wire
PA14.Signal=SYS_JTCK-SWCLK
PA2.GPIO_Label=Pix15_En
PA2.PinState=GPIO_PIN_SET
PA2.Signal=GPIO_Output
PA3.GPIO_Label=Pix16_Xs
PA3.PinState=GPIO_PIN_SET
PA3.Signal=GPIO_Output
PA4.GPIO_Label=LED1
PA4.PinState=GPIO_PIN_SET
PA4.Signal=GPIO_Output
PA5.GPIO_Label=LED2
PA5.PinState=GPIO_PIN_SET
PA5.Signal=GPIO_Output
PA6.GPIO_Label=LED3
PA6.PinState=GPIO_PIN_SET
PA6.Signal=GPIO_Output
PA7.GPIO_Label=LED4
PA7.PinState=GPIO_PIN_SET
PA7.Signal=GPIO_Output
PA8.GPIO_Label=Pix31_En
PA8.PinState=GPIO_PIN_SET
PA8.Signal=GPIO_Output
PA9.GPIO_Label=Pix31_Dir
PA9.Signal=GPIO_Output
PB0.GPIO_Label=LED7
PB0.PinState=GPIO_PIN_SET
PB0.Signal=GPIO_Output
PB1.Signal=S_TIM3_CH4
PB10.GPIO_Label=Pix22_Xs
PB10.PinState=GPIO_PIN_SET
PB10.Signal=GPIO_Output
PB11.GPIO_Label=Pix22_En
PB11.PinState=GPIO_PIN_SET
PB11.Signal=GPIO_Output
PB12.GPIO_Label=Pix24_Xs
PB12.PinState=GPIO_PIN_SET
PB12.Signal=GPIO_Output
PB13.GPIO_Label=Pix24_En
PB13.PinState=GPIO_PIN_SET
PB13.Signal=GPIO_Output
PB14.GPIO_Label=Pix24_Dir
PB14.PinState=GPIO_PIN_RESET
PB14.Signal=GPIO_Output
PB15.GPIO_Label=Pix24_PW
PB15.PinState=GPIO_PIN_SET
PB15.Signal=GPIO_Output
PB2.GPIO_Label=Pix17_Xs
PB2.PinState=GPIO_PIN_SET
PB2.Signal=GPIO_Output
PB5.GPIO_Label=Pix07_Dir
PB5.PinState=GPIO_PIN_RESET
PB5.Signal=GPIO_Output
PB6.Mode=I2C
PB6.Signal=I2C1_SCL
PB7.Mode=I2C
PB7.Signal=I2C1_SDA
PB8.GPIO_PuPd=GPIO_PULLUP
PB8.GPIO_Speed=GPIO_SPEED_FREQ_VERY_HIGH
PB8.Mode=CAN_Activate
PB8.Signal=CAN1_RX
PB9.Mode=CAN_Activate
PB9.Signal=CAN1_TX
PC0.GPIO_Label=Pix14_PW
PC0.PinState=GPIO_PIN_SET
PC0.Signal=GPIO_Output
PC1.GPIO_Label=Pix14_Dir
PC1.PinState=GPIO_PIN_RESET
PC1.Signal=GPIO_Output
PC10.GPIO_Label=Pix01_PW
PC10.PinState=GPIO_PIN_SET
PC10.Signal=GPIO_Output
PC11.GPIO_Label=Pix01_Dir
PC11.PinState=GPIO_PIN_RESET
PC11.Signal=GPIO_Output
PC12.GPIO_Label=Pix01_En
PC12.PinState=GPIO_PIN_SET
PC12.Signal=GPIO_Output
PC13.GPIO_Label=Pix10_PW
PC13.PinState=GPIO_PIN_SET
PC13.Signal=GPIO_Output
PC14/OSC32_IN.Mode=LSE-External-Oscillator
PC14/OSC32_IN.Signal=RCC_OSC32_IN
PC15/OSC32_OUT.Mode=LSE-External-Oscillator
PC15/OSC32_OUT.Signal=RCC_OSC32_OUT
PC2.GPIO_Label=Pix14_En
PC2.PinState=GPIO_PIN_SET
PC2.Signal=GPIO_Output
PC3.GPIO_Label=Pix14_Xs
PC3.PinState=GPIO_PIN_SET
PC3.Signal=GPIO_Output
PC4.GPIO_Label=LED5
PC4.PinState=GPIO_PIN_SET
PC4.Signal=GPIO_Output
PC5.GPIO_Label=LED6
PC5.PinState=GPIO_PIN_SET
PC5.Signal=GPIO_Output
PC6.GPIO_Label=Pix30_En
PC6.PinState=GPIO_PIN_SET
PC6.Signal=GPIO_Output
PC7.GPIO_Label=Pix30_Dir
PC7.PinState=GPIO_PIN_RESET
PC7.Signal=GPIO_Output
PC8.GPIO_Label=Pix30_PW
PC8.PinState=GPIO_PIN_SET
PC8.Signal=GPIO_Output
PC9.GPIO_Label=Pix31_Xs
PC9.PinState=GPIO_PIN_SET
PC9.Signal=GPIO_Output
PD0.GPIO_Label=Pix01_Xs
PD0.PinState=GPIO_PIN_SET
PD0.Signal=GPIO_Output
PD1.GPIO_Label=Pix02_PW
PD1.PinState=GPIO_PIN_SET
PD1.Signal=GPIO_Output
PD10.GPIO_Label=Pix24_Xs
PD10.PinState=GPIO_PIN_SET
PD10.Signal=GPIO_Output
PD11.GPIO_Label=Pix25_En
PD11.PinState=GPIO_PIN_SET
PD11.Signal=GPIO_Output
PD12.GPIO_Label=Pix25_Dir
PD12.PinState=GPIO_PIN_RESET
PD12.Signal=GPIO_Output
PD13.GPIO_Label=Pix25_PW
PD13.PinState=GPIO_PIN_SET
PD13.Signal=GPIO_Output
PD15.GPIO_Label=Pix26_Xs
PD15.PinState=GPIO_PIN_SET
PD15.Signal=GPIO_Output
PD2.GPIO_Label=Pix02_Dir
PD2.PinState=GPIO_PIN_RESET
PD2.Signal=GPIO_Output
PD3.GPIO_Label=Pix02_En
PD3.PinState=GPIO_PIN_SET
PD3.Signal=GPIO_Output
PD4.GPIO_Label=Pix02_Xs
PD4.PinState=GPIO_PIN_SET
PD4.Signal=GPIO_Output
PD5.Mode=Asynchronous
PD5.Signal=USART2_TX
PD6.Mode=Asynchronous
PD6.Signal=USART2_RX
PD7.GPIO_Label=Pix03_PW
PD7.PinState=GPIO_PIN_SET
PD7.Signal=GPIO_Output
PE0.GPIO_Label=Pix07_En
PE0.PinState=GPIO_PIN_SET
PE0.Signal=GPIO_Output
PE1.GPIO_Label=Pix07_En
PE1.PinState=GPIO_PIN_SET
PE1.Signal=GPIO_Output
PE10.GPIO_Label=Pix20_Dir
PE10.PinState=GPIO_PIN_RESET
PE10.Signal=GPIO_Output
PE11.GPIO_Label=Pix20_PW
PE11.PinState=GPIO_PIN_SET
PE11.Signal=GPIO_Output
PE12.GPIO_Label=Pix21_Xs
PE12.PinState=GPIO_PIN_SET
PE12.Signal=GPIO_Output
PE13.GPIO_Label=Pix21_En
PE13.PinState=GPIO_PIN_SET
PE13.Signal=GPIO_Output
PE14.GPIO_Label=Pix21_Dir
PE14.PinState=GPIO_PIN_RESET
PE14.Signal=GPIO_Output
PE15.GPIO_Label=Pix21_PW
PE15.PinState=GPIO_PIN_SET
PE15.Signal=GPIO_Output
PE2.GPIO_Label=Pix08_En
PE2.PinState=GPIO_PIN_SET
PE2.Signal=GPIO_Output
PE3.GPIO_Label=Pix08_Xs
PE3.PinState=GPIO_PIN_SET
PE3.Signal=GPIO_Output
PE4.GPIO_Label=Pix09_PW
PE4.PinState=GPIO_PIN_SET
PE4.Signal=GPIO_Output
PE5.GPIO_Label=Pix09_Dir
PE5.PinState=GPIO_PIN_RESET
PE5.Signal=GPIO_Output
PE6.GPIO_Label=Pix09_En
PE6.PinState=GPIO_PIN_SET
PE6.Signal=GPIO_Output
PE7.GPIO_Label=Pix20_Xs
PE7.PinState=GPIO_PIN_SET
PE7.Signal=GPIO_Output
PE8.GPIO_Label=Pix20_En
PE8.PinState=GPIO_PIN_SET
PE8.Signal=GPIO_Output
PF0.Mode=I2C
PF0.Signal=I2C2_SDA
PF1.Mode=I2C
PF1.Signal=I2C2_SCL
PF10.GPIO_Label=Pix13_Xs
PF10.PinState=GPIO_PIN_SET
PF10.Signal=GPIO_Output
PF11.GPIO_Label=Pix18_PW
PF11.PinState=GPIO_PIN_SET
PF11.Signal=GPIO_Output
PF12.GPIO_Label=Pix19_Xs
PF12.PinState=GPIO_PIN_SET
PF12.Signal=GPIO_Output
PF13.GPIO_Label=Pix19_En
PF13.PinState=GPIO_PIN_SET
PF13.Signal=GPIO_Output
PF14.Mode=I2C
PF14.Signal=I2C4_SCL
PF15.Mode=I2C
PF15.Signal=I2C4_SDA
PF2.GPIO_Label=Pix11_PW
PF2.PinState=GPIO_PIN_SET
PF2.Signal=GPIO_Output
PF3.GPIO_Label=Pix12_PW
PF3.PinState=GPIO_PIN_SET
PF3.Signal=GPIO_Output
PF4.GPIO_Label=Pix12_Dir
PF4.PinState=GPIO_PIN_RESET
PF4.Signal=GPIO_Output
PF5.GPIO_Label=Pix12_En
PF5.PinState=GPIO_PIN_SET
PF5.Signal=GPIO_Output
PF6.GPIO_Label=Pix12_Xs
PF6.PinState=GPIO_PIN_SET
PF6.Signal=GPIO_Output
PF7.GPIO_Label=Pix13_PW
PF7.PinState=GPIO_PIN_SET
PF7.Signal=GPIO_Output
PF8.GPIO_Label=Pix13_Dir
PF8.PinState=GPIO_PIN_RESET
PF8.Signal=GPIO_Output
PF9.GPIO_Label=Pix13_En
PF9.PinState=GPIO_PIN_SET
PF9.Signal=GPIO_Output
PG0.GPIO_Label=Pix19_Dir
PG0.PinState=GPIO_PIN_RESET
PG0.Signal=GPIO_Output
PG1.GPIO_Label=Pix19_PW
PG1.PinState=GPIO_PIN_SET
PG1.Signal=GPIO_Output
PG10.GPIO_Label=Pix04_En
PG10.PinState=GPIO_PIN_SET
PG10.Signal=GPIO_Output
PG11.GPIO_Label=Pix04_Xs
PG11.PinState=GPIO_PIN_SET
PG11.Signal=GPIO_Output
PG12.GPIO_Label=Pix05_PW
PG12.PinState=GPIO_PIN_SET
PG12.Signal=GPIO_Output
PG13.GPIO_Label=Pix05_Dir
PG13.PinState=GPIO_PIN_RESET
PG13.Signal=GPIO_Output
PG14.GPIO_Label=Pix05_En
PG14.PinState=GPIO_PIN_SET
PG14.Signal=GPIO_Output
PG15.GPIO_Label=Pix07_PW
PG15.PinState=GPIO_PIN_SET
PG15.Signal=GPIO_Output
PG2.GPIO_Label=Pix28_Dir
PG2.PinState=GPIO_PIN_RESET
PG2.Signal=GPIO_Output
PG3.GPIO_Label=Pix28_PW
PG3.PinState=GPIO_PIN_SET
PG3.Signal=GPIO_Output
PG4.GPIO_Label=Pix29_Xs
PG4.PinState=GPIO_PIN_SET
PG4.Signal=GPIO_Output
PG5.GPIO_Label=Pix29_En
PG5.PinState=GPIO_PIN_SET
PG5.Signal=GPIO_Output
PG6.GPIO_Label=Pix29_Dir
PG6.PinState=GPIO_PIN_SET
PG6.Signal=GPIO_Output
PG7.GPIO_Label=Pix29_PW
PG7.PinState=GPIO_PIN_SET
PG7.Signal=GPIO_Output
PG8.GPIO_Label=Pix30_Xs
PG8.PinState=GPIO_PIN_SET
PG8.Signal=GPIO_Output
PG9.GPIO_Label=Pix04_Dir
PG9.PinState=GPIO_PIN_SET
PG9.Signal=GPIO_Output
PH0/OSC_IN.Mode=HSE-External-Oscillator
PH0/OSC_IN.Signal=RCC_OSC_IN
PH1/OSC_OUT.Mode=HSE-External-Oscillator
PH1/OSC_OUT.Signal=RCC_OSC_OUT
PH10.GPIO_Label=Pix23_En
PH10.PinState=GPIO_PIN_SET
PH10.Signal=GPIO_Output
PH11.GPIO_Label=Pix23_Dir
PH11.PinState=GPIO_PIN_RESET
PH11.Signal=GPIO_Output
PH12.GPIO_Label=Pix23_PW
PH12.PinState=GPIO_PIN_SET
PH12.Signal=GPIO_Output
PH13.GPIO_Label=Pix32_Dir
PH13.PinState=GPIO_PIN_RESET
PH13.Signal=GPIO_Output
PH14.GPIO_Label=Pix32_PW
PH14.PinState=GPIO_PIN_SET
PH14.Signal=GPIO_Output
PH15.GPIO_Label=Pix33_Xs
PH15.PinState=GPIO_PIN_SET
PH15.Signal=GPIO_Output
PH2.GPIO_Label=Pix15_Xs
PH2.PinState=GPIO_PIN_SET
PH2.Signal=GPIO_Output
PH3.GPIO_Label=Pix16_PW
PH3.PinState=GPIO_PIN_SET
PH3.Signal=GPIO_Output
PH4.GPIO_Label=Pix16_Dir
PH4.PinState=GPIO_PIN_RESET
PH4.Signal=GPIO_Output
PH5.GPIO_Label=Pix16_En
PH5.PinState=GPIO_PIN_SET
PH5.Signal=GPIO_Output
PH6.GPIO_Label=Pix22_PW
PH6.PinState=GPIO_PIN_SET
PH6.Signal=GPIO_Output
PH7.Mode=I2C
PH7.Signal=I2C3_SCL
PH8.Mode=I2C
PH8.Signal=I2C3_SDA
PH9.GPIO_Label=Pix23_Xs
PH9.PinState=GPIO_PIN_SET
PH9.Signal=GPIO_Output
PI0.GPIO_Label=Pix33_En
PI0.PinState=GPIO_PIN_SET
PI0.Signal=GPIO_Output
PI1.GPIO_Label=Pix33_Dir
PI1.PinState=GPIO_PIN_SET
PI1.Signal=GPIO_Output
PI10.GPIO_Label=Pix10_En
PI10.PinState=GPIO_PIN_SET
PI10.Signal=GPIO_Output
PI11.GPIO_Label=Pix11_Xs
PI11.PinState=GPIO_PIN_SET
PI11.Signal=GPIO_Output
PI12.GPIO_Label=Pix11_Dir
PI12.PinState=GPIO_PIN_RESET
PI12.Signal=GPIO_Output
PI13.GPIO_Label=Pix11_En
PI13.PinState=GPIO_PIN_SET
PI13.Signal=GPIO_Output
PI14.GPIO_Label=Pix11_Xs
PI14.PinState=GPIO_PIN_SET
PI14.Signal=GPIO_Output
PI15.GPIO_Label=Pix17_En
PI15.PinState=GPIO_PIN_SET
PI15.Signal=GPIO_Output
PI2.GPIO_Label=Pix33_PW
PI2.PinState=GPIO_PIN_SET
PI2.Signal=GPIO_Output
PI6.GPIO_Label=Pix08_PW
PI6.PinState=GPIO_PIN_SET
PI6.Signal=GPIO_Output
PI7.GPIO_Label=Pix08_Dir
PI7.PinState=GPIO_PIN_RESET
PI7.Signal=GPIO_Output
PI8.GPIO_Label=Pix09_Xs
PI8.PinState=GPIO_PIN_SET
PI8.Signal=GPIO_Output
PI9.GPIO_Label=Pix10_Dir
PI9.PinState=GPIO_PIN_RESET
PI9.Signal=GPIO_Output
PJ0.GPIO_Label=Pix17_Dir
PJ0.PinState=GPIO_PIN_RESET
PJ0.Signal=GPIO_Output
PJ1.GPIO_Label=Pix17_PW
PJ1.PinState=GPIO_PIN_SET
PJ1.Signal=GPIO_Output
PJ10.GPIO_Label=Pix27_En
PJ10.PinState=GPIO_PIN_SET
PJ10.Signal=GPIO_Output
PJ11.GPIO_Label=Pix27_Dir
PJ11.PinState=GPIO_PIN_RESET
PJ11.Signal=GPIO_Output
PJ12.GPIO_Label=Pix03_Dir
PJ12.PinState=GPIO_PIN_RESET
PJ12.Signal=GPIO_Output
PJ13.GPIO_Label=Pix03_En
PJ13.PinState=GPIO_PIN_SET
PJ13.Signal=GPIO_Output
PJ14.GPIO_Label=Pix03_Xs
PJ14.PinState=GPIO_PIN_SET
PJ14.Signal=GPIO_Output
PJ15.GPIO_Label=Pix04_PW
PJ15.PinState=GPIO_PIN_SET
PJ15.Signal=GPIO_Output
PJ2.GPIO_Label=Pix18_Xs
PJ2.PinState=GPIO_PIN_SET
PJ2.Signal=GPIO_Output
PJ3.GPIO_Label=Pix18_En
PJ3.PinState=GPIO_PIN_SET
PJ3.Signal=GPIO_Output
PJ4.GPIO_Label=Pix18_Dir
PJ4.PinState=GPIO_PIN_RESET
PJ4.Signal=GPIO_Output
PJ5.GPIO_Label=Pix22_Dir
PJ5.PinState=GPIO_PIN_RESET
PJ5.Signal=GPIO_Output
PJ6.GPIO_Label=Pix26_En
PJ6.PinState=GPIO_PIN_SET
PJ6.Signal=GPIO_Output
PJ7.GPIO_Label=Pix26_Dir
PJ7.PinState=GPIO_PIN_RESET
PJ7.Signal=GPIO_Output
PJ8.GPIO_Label=Pix26_PW
PJ8.PinState=GPIO_PIN_SET
PJ8.Signal=GPIO_Output
PJ9.GPIO_Label=Pix27_Xs
PJ9.PinState=GPIO_PIN_SET
PJ9.Signal=GPIO_Output
PK0.GPIO_Label=Pix27_PW
PK0.PinState=GPIO_PIN_SET
PK0.Signal=GPIO_Output
PK1.GPIO_Label=Pix28_Xs
PK1.PinState=GPIO_PIN_SET
PK1.Signal=GPIO_Output
PK2.GPIO_Label=Pix28_En
PK2.PinState=GPIO_PIN_SET
PK2.Signal=GPIO_Output
PK3.GPIO_Label=Pix05_Xs
PK3.PinState=GPIO_PIN_SET
PK3.Signal=GPIO_Output
PK4.GPIO_Label=Pix06_PW
PK4.PinState=GPIO_PIN_SET
PK4.Signal=GPIO_Output
PK5.GPIO_Label=Pix06_Dir
PK5.PinState=GPIO_PIN_RESET
PK5.Signal=GPIO_Output
PK6.GPIO_Label=Pix06_En
PK6.PinState=GPIO_PIN_SET
PK6.Signal=GPIO_Output
PK7.GPIO_Label=Pix06_Xs
PK7.PinState=GPIO_PIN_SET
PK7.Signal=GPIO_Output
ProjectManager.HeapSize=0x200
ProjectManager.StackSize=0x400
ProjectManager.TargetToolchain=STM32CubeIDE
RCC.AHBFreq_Value=216000000
RCC.APB1CLKDivider=RCC_HCLK_DIV4
RCC.APB1Freq_Value=54000000
RCC.APB1TimFreq_Value=108000000
RCC.APB2CLKDivider=RCC_HCLK_DIV2
RCC.APB2Freq_Value=108000000
RCC.APB2TimFreq_Value=216000000
RCC.CortexFreq_Value=216000000
RCC.HCLKFreq_Value=216000000
RCC.HSE_VALUE=8000000
RCC.HSI_VALUE=16000000
RCC.PLLM=4
RCC.PLLN=216
RCC.PLLSourceVirtual=RCC_PLLSOURCE_HSE
RCC.SYSCLKFreq_VALUE=216000000
RCC.SYSCLKSource=RCC_SYSCLKSOURCE_PLLCLK
RCC.USART2CLockSelection=RCC_USART2CLKSOURCE_HSI
RCC.USBFreq_Value=216000000
RCC.VCOOutputFreq_Value=432000000
SH.S_TIM3_CH4.0=TIM3_CH4,PWM Generation4 CH4
TIM3.Channel-PWM\ Generation4\ CH4=TIM_CHANNEL_4
TIM3.Period=10000
TIM3.Prescaler=10
USART2.BaudRate=9600
USART2.VirtualMode-Asynchronous=VM_ASYNC
VP_FREERTOS_VS_CMSIS_V2.Mode=CMSIS_V2
VP_TIM3_VS_ClockSourceINT.Mode=Internal
board=custom

// file: Core/Src/main.c
/* USER CODE BEGIN Header */
/**
  ******************************************************************************
  * @file           : main.c
  * @brief          : Main program body
  ******************************************************************************
  * @attention
  *
  * Copyright (c) 2026 STMicroelectronics.
  * All rights reserved.
  *
  * This software is licensed under terms that can be found in the LICENSE file
  * in the root directory of this software component.
  * If no LICENSE file comes with this software, it is provided AS-IS.
  *
  ******************************************************************************
  */
/* USER CODE END Header */
#include "main.h"
#include "cmsis_os.h"
#include "can.h"
#include "i2c.h"
#include "tim.h"
#include "usart.h"
#include "gpio.h"

/* USER CODE BEGIN Includes */
#include <stdio.h>
/* USER CODE END Includes */

void SystemClock_Config(void);
static void MPU_Config(void);
void MX_FREERTOS_Init(void);

/* USER CODE BEGIN 0 */
int _write(int file, char *ptr, int len)
{
  HAL_UART_Transmit(&huart2, (uint8_t*)ptr, len, HAL_MAX_DELAY);
  return len;
}
/*---------------------------------------------------------------------------k-*/
uint8_t test2_3;

/*----------------------------------------------------------------------------*/

/* USER CODE END 0 */

int main(void)
{

  /* MPU Configuration--------------------------------------------------------*/
  MPU_Config();

  /* MCU Configuration--------------------------------------------------------*/

  /* Reset of all peripherals, Initializes the Flash interface and the Systick. */
  HAL_Init();

  /* Configure the system clock */
  SystemClock_Config();

  /* Initialize all configured peripherals */
  MX_GPIO_Init();
  MX_CAN1_Init();
  MX_I2C1_Init();
  MX_I2C2_Init();
  MX_I2C4_Init();
  MX_USART2_UART_Init();
  MX_I2C3_Init();
  MX_TIM3_Init();
  /* USER CODE BEGIN 2 */
  HAL_Delay(300);
  printf("Boot\r\n");

  /* USER CODE END 2 */

  /* Init scheduler */
  osKernelInitialize();

  /* Call init function for freertos objects (in cmsis_os2.c) */
  MX_FREERTOS_Init();

  /* Start scheduler */
  osKernelStart();

  /* We should never get here as control is now taken by the scheduler */

  /* Infinite loop */
  while (1)
  {

  }
}

void SystemClock_Config(void)
{
  RCC_OscInitTypeDef RCC_OscInitStruct = {0};
  RCC_ClkInitTypeDef RCC_ClkInitStruct = {0};

  /** Configure LSE Drive Capability
  */
  HAL_PWR_EnableBkUpAccess();

  /** Configure the main internal regulator output voltage
  */
  __HAL_RCC_PWR_CLK_ENABLE();
  __HAL_PWR_VOLTAGESCALING_CONFIG(PWR_REGULATOR_VOLTAGE_SCALE1);

  /** Initializes the RCC Oscillators according to the specified parameters
  * in the RCC_OscInitTypeDef structure.
  */
  RCC_OscInitStruct.OscillatorType = RCC_OSCILLATORTYPE_HSI|RCC_OSCILLATORTYPE_HSE;
  RCC_OscInitStruct.HSEState = RCC_HSE_ON;
  RCC_OscInitStruct.HSIState = RCC_HSI_ON;
  RCC_OscInitStruct.HSICalibrationValue = RCC_HSICALIBRATION_DEFAULT;
  RCC_OscInitStruct.PLL.PLLState = RCC_PLL_ON;
  RCC_OscInitStruct.PLL.PLLSource = RCC_PLLSOURCE_HSE;
  RCC_OscInitStruct.PLL.PLLM = 4;
  RCC_OscInitStruct.PLL.PLLN = 216;
  RCC_OscInitStruct.PLL.PLLP = RCC_PLLP_DIV2;
  RCC_OscInitStruct.PLL.PLLQ = 2;
  RCC_OscInitStruct.PLL.PLLR = 2;
  if (HAL_RCC_OscConfig(&RCC_OscInitStruct) != HAL_OK)
  {
    Error_Handler();
  }

  /** Activate the Over-Drive mode
  */
  if (HAL_PWREx_EnableOverDrive() != HAL_OK)
  {
    Error_Handler();
  }

  /** Initializes the CPU, AHB and APB buses clocks
  */
  RCC_ClkInitStruct.ClockType = RCC_CLOCKTYPE_HCLK|RCC_CLOCKTYPE_SYSCLK
                              |RCC_CLOCKTYPE_PCLK1|RCC_CLOCKTYPE_PCLK2;
  RCC_ClkInitStruct.SYSCLKSource = RCC_SYSCLKSOURCE_PLLCLK;
  RCC_ClkInitStruct.AHBCLKDivider = RCC_SYSCLK_DIV1;
  RCC_ClkInitStruct.APB1CLKDivider = RCC_HCLK_DIV4;
  RCC_ClkInitStruct.APB2CLKDivider = RCC_HCLK_DIV2;

  if (HAL_RCC_ClockConfig(&RCC_ClkInitStruct, FLASH_LATENCY_7) != HAL_OK)
  {
    Error_Handler();
  }
}

 /* MPU Configuration */

void MPU_Config(void)
{
  MPU_Region_InitTypeDef MPU_InitStruct = {0};

  /* Disables the MPU */
  HAL_MPU_Disable();

  /** Initializes and configures the Region and the memory to be protected
  */
  MPU_InitStruct.Enable = MPU_REGION_ENABLE;
  MPU_InitStruct.Number = MPU_REGION_NUMBER0;
  MPU_InitStruct.BaseAddress = 0x0;
  MPU_InitStruct.Size = MPU_REGION_SIZE_4GB;
  MPU_InitStruct.SubRegionDisable = 0x87;
  MPU_InitStruct.TypeExtField = MPU_TEX_LEVEL0;
  MPU_InitStruct.AccessPermission = MPU_REGION_NO_ACCESS;
  MPU_InitStruct.DisableExec = MPU_INSTRUCTION_ACCESS_DISABLE;
  MPU_InitStruct.IsShareable = MPU_ACCESS_SHAREABLE;
  MPU_InitStruct.IsCacheable = MPU_ACCESS_NOT_CACHEABLE;
  MPU_InitStruct.IsBufferable = MPU_ACCESS_NOT_BUFFERABLE;

  HAL_MPU_ConfigRegion(&MPU_InitStruct);
  /* Enables the MPU */
  HAL_MPU_Enable(MPU_PRIVILEGED_DEFAULT);

}

void Error_Handler(void)
{
  __disable_irq();
  while (1)
  {
  }
}

// file: Core/Src/freertos.c
/* USER CODE BEGIN Header */
/**
  ******************************************************************************
  * File Name          : freertos.c
  * Description        : Code for freertos applications
  ******************************************************************************
  * @attention
  *
  * Copyright (c) 2026 STMicroelectronics.
  * All rights reserved.
  *
  * This software is licensed under terms that can be found in the LICENSE file
  * in the root directory of this software component.
  * If no LICENSE file comes with this software, it is provided AS-IS.
  *
  ******************************************************************************
  */
/* USER CODE END Header */

#include "FreeRTOS.h"
#include "task.h"
#include "main.h"
#include "cmsis_os.h"

/* USER CODE BEGIN Includes */
#include "can_app.h"
#include "can_node.h"
#include "v_VL53L4CD.h"
#include "platform.h"
#include "i2c.h"
#include "v_Sensor.h"
#include "utils.h"
#include "queue.h"
#include <stdio.h>
#include "stepperMotor.h"
#include "motor_cmd.h"
#include <stdio.h>
#include "sensor_baseline.h"
#include "sensor_health.h"
#include "motor_control.h"
#include "tim.h"
#include "node_test.h"
/* USER CODE END Includes */

typedef StaticTask_t osStaticThreadDef_t;
//2

/* USER CODE BEGIN PD */
#define SENSOR_QUEUE_LEN        1
#define DEBUG_TASK_STACK_WORDS  256
#define NODETX_TASK_STACK_WORDS 512
/* USER CODE END PD */

/* USER CODE BEGIN Variables */
QueueHandle_t qSensors = NULL;
extern QueueHandle_t canRxQueue;
/* USER CODE END Variables */
/* Definitions for defaultTask */
osThreadId_t defaultTaskHandle;
const osThreadAttr_t defaultTask_attributes = {
  .name = "defaultTask",
  .stack_size = 128 * 4,
  .priority = (osPriority_t) osPriorityNormal,
};
/* Definitions for v_SensorTask */
osThreadId_t v_SensorTaskHandle;
uint32_t SensorTaskBuffer[ 1024 ];
osStaticThreadDef_t SensorTaskControlBlock;
const osThreadAttr_t v_SensorTask_attributes = {
  .name = "v_SensorTask",
  .cb_mem = &SensorTaskControlBlock,
  .cb_size = sizeof(SensorTaskControlBlock),
  .stack_mem = &SensorTaskBuffer[0],
  .stack_size = sizeof(SensorTaskBuffer),
  .priority = (osPriority_t) osPriorityNormal,
};
/* Definitions for v_CmdTask */
osThreadId_t v_CmdTaskHandle;
uint32_t v_CmdTaskBuffer[ 1024 ];
osStaticThreadDef_t v_CmdTaskControlBlock;
const osThreadAttr_t v_CmdTask_attributes = {
  .name = "v_CmdTask",
  .cb_mem = &v_CmdTaskControlBlock,
  .cb_size = sizeof(v_CmdTaskControlBlock),
  .stack_mem = &v_CmdTaskBuffer[0],
  .stack_size = sizeof(v_CmdTaskBuffer),
  .priority = (osPriority_t) osPriorityAboveNormal,
};
/* Definitions for v_CanTxTask */
osThreadId_t v_CanTxTaskHandle;
uint32_t v_CanTxTaskBuffer[ 512 ];
osStaticThreadDef_t v_CanTxTaskControlBlock;
const osThreadAttr_t v_CanTxTask_attributes = {
  .name = "v_CanTxTask",
  .cb_mem = &v_CanTxTaskControlBlock,
  .cb_size = sizeof(v_CanTxTaskControlBlock),
  .stack_mem = &v_CanTxTaskBuffer[0],
  .stack_size = sizeof(v_CanTxTaskBuffer),
  .priority = (osPriority_t) osPriorityAboveNormal,
};

/* Definitions for v_TestTask */
osThreadId_t v_TestTaskHandle;
uint32_t v_TestTaskBuffer[512];
osStaticThreadDef_t v_TestTaskControlBlock;

const osThreadAttr_t v_TestTask_attributes = {
  .name = "v_TestTask",
  .cb_mem = &v_TestTaskControlBlock,
  .cb_size = sizeof(v_TestTaskControlBlock),
  .stack_mem = &v_TestTaskBuffer[0],
  .stack_size = sizeof(v_TestTaskBuffer),
  .priority = (osPriority_t) osPriorityLow,
};

/* USER CODE BEGIN FunctionPrototypes */
void DebugTask(void *argument);
void CAN_NodeTxTask(void *argument);

/* USER CODE END FunctionPrototypes */

void StartDefaultTask(void *argument);
void SensorTask(void *argument);
void CmdTask(void *argument);
void CanTxTask(void *argument);

void MX_FREERTOS_Init(void); /* (MISRA C 2004 rule 8.1) */

void MX_FREERTOS_Init(void) {
  /* USER CODE BEGIN Init */
	CAN_AppInit();
	CAN_AppStart();
	stepper_init();
	// مقداردهی اولیه مانیتور سلامت سنسورها
	// NOTE:
	// این فقط history داخلی health را پاک می‌کند.
	// baseline جداگانه بعد از init سنسورها شروع می‌شود.
	SensorHealth_Init();
	// مقداردهی اولیه لایه کنترل موتور
	// NOTE:
	// stepper_init سخت‌افزار را آماده می‌کند.
	// MotorControl_Init فقط state نرم‌افزاری actuatorها را آماده می‌کند.
	MotorControl_Init();

	qSensors = xQueueCreate(1, sizeof(tof_payload_t));
	if(qSensors == NULL)  Error_Handler();

	  if (xTaskCreate(DebugTask,
	                  "DBG",
	                  DEBUG_TASK_STACK_WORDS,
	                  NULL,
	                  tskIDLE_PRIORITY + 1,
	                  NULL) != pdPASS) {
	    Error_Handler();
	  }

	  if (xTaskCreate(CAN_NodeTxTask,
	                    "NodeTX",
	                    NODETX_TASK_STACK_WORDS,
	                    NULL,
	                    tskIDLE_PRIORITY + 2,
	                    NULL) != pdPASS) {
	      Error_Handler();
	    }

  /* USER CODE END Init */

  /* Create the thread(s) */
  /* creation of defaultTask */
  defaultTaskHandle = osThreadNew(StartDefaultTask, NULL, &defaultTask_attributes);

  /* creation of v_SensorTask */
  v_SensorTaskHandle = osThreadNew(SensorTask, NULL, &v_SensorTask_attributes);

  /* creation of v_CmdTask */
  v_CmdTaskHandle = osThreadNew(CmdTask, NULL, &v_CmdTask_attributes);

  /* creation of v_CanTxTask */
  v_CanTxTaskHandle = osThreadNew(CanTxTask, NULL, &v_CanTxTask_attributes);

  if ((defaultTaskHandle == NULL) ||
      (v_SensorTaskHandle == NULL) ||
      (v_CmdTaskHandle == NULL) ||
      (v_CanTxTaskHandle == NULL)) {
    Error_Handler();
  }

  // ایجاد task تست‌ها
  // NOTE:
  // تمام تست‌های توسعه‌ای داخل TestTask اجرا می‌شوند.
  // با ماکروهای node_test.h می‌توان هر تست را فعال/غیرفعال کرد.
  v_TestTaskHandle = osThreadNew(TestTask, NULL, &v_TestTask_attributes);

}

void StartDefaultTask(void *argument)
{
  /* USER CODE BEGIN StartDefaultTask */
	HAL_GPIO_WritePin(GPIOA, GPIO_PIN_5, GPIO_PIN_SET);
	HAL_Delay(100);
	HAL_GPIO_WritePin(GPIOA, GPIO_PIN_5, GPIO_PIN_RESET);
	HAL_Delay(100);
	HAL_GPIO_WritePin(GPIOA, GPIO_PIN_5, GPIO_PIN_SET);
	HAL_Delay(100);
	HAL_GPIO_WritePin(GPIOA, GPIO_PIN_5, GPIO_PIN_RESET);
	HAL_Delay(100);
	HAL_GPIO_WritePin(GPIOA, GPIO_PIN_5, GPIO_PIN_SET);
	HAL_Delay(100);
	HAL_GPIO_WritePin(GPIOA, GPIO_PIN_5, GPIO_PIN_RESET);
	HAL_Delay(100);
	HAL_GPIO_WritePin(GPIOA, GPIO_PIN_5, GPIO_PIN_SET);
	HAL_Delay(100);
	HAL_GPIO_WritePin(GPIOA, GPIO_PIN_5, GPIO_PIN_RESET);
	HAL_Delay(100);
	HAL_GPIO_WritePin(GPIOA, GPIO_PIN_5, GPIO_PIN_SET);
	HAL_Delay(100);
	HAL_GPIO_WritePin(GPIOA, GPIO_PIN_5, GPIO_PIN_RESET);
	HAL_Delay(100);
	HAL_GPIO_WritePin(GPIOA, GPIO_PIN_5, GPIO_PIN_SET);
	HAL_Delay(100);
	HAL_GPIO_WritePin(GPIOA, GPIO_PIN_5, GPIO_PIN_RESET);
  /* Infinite loop */
  for(;;)
  {
	  static uint8_t heat_beat;
	  heat_beat++;
	Motor_Process();

	  if(heat_beat % 100 == 0)
	  {
		  HAL_GPIO_WritePin(GPIOA, GPIO_PIN_5, GPIO_PIN_RESET);
	  }
	  else if(heat_beat % 120 == 0)
	  {
		  heat_beat= 0;
		  HAL_GPIO_WritePin(GPIOA, GPIO_PIN_5, GPIO_PIN_SET);
	  }

    osDelay(10);
  }
  /* USER CODE END StartDefaultTask */
}

void SensorTask(void *argument)
{
  (void)argument;

	#if DBG_BUS_STATUS
		TickType_t lastPrint = 0;   // NOTE: فقط وقتی debug باس فعال است استفاده می‌شود
	#endif

  tof_payload_t pkt;

  memset(&pkt, 0, sizeof(pkt));

  initialize_ptrTof_1_data();

  /* ---------------- Multi-bus sensor init ---------------- */
  VL53L4CD_SetI2CHandle(&hi2c1);
  VL53L4CD_Init_Multi_I2C1();

  VL53L4CD_SetI2CHandle(&hi2c2);
  VL53L4CD_Init_Multi_I2C2();

  VL53L4CD_SetI2CHandle(&hi2c3);
  VL53L4CD_Init_Multi_I2C3();

  VL53L4CD_SetI2CHandle(&hi2c4);
  VL53L4CD_Init_Multi_I2C4();

  // شروع baseline بعد از init کامل سنسورها
  // NOTE: اینجا سنسورها address گرفته‌اند و آماده read هستند
  SensorBaseline_Start();

  printf("SensorTask started\r\n");

  for (;;)
  {

	  if (g_sensor_cal_busy)
	  {
	      // Calibration به دسترسی انحصاری به سنسور نیاز دارد.
	      // بنابراین هنگام calibration، read و baseline و health را اجرا نمی‌کنیم.
	      osDelay(20);
	      continue;
	  }

    /* فقط باس‌های فعال خوانده شوند */
    if (v_I2C1_Bus) VL53L4CD_SensorRead_I2C1();
    if (v_I2C2_Bus) VL53L4CD_SensorRead_I2C2();
    if (v_I2C3_Bus) VL53L4CD_SensorRead_I2C3();
    if (v_I2C4_Bus) VL53L4CD_SensorRead_I2C4();

    // پردازش baseline بعد از به‌روزرسانی data[]
    // NOTE:
    // baseline باید بعد از SensorRead اجرا شود،
    // چون از ptrTof_1->data[] و sens_status[] نمونه می‌گیرد.
    SensorBaseline_Process();
    if (SensorBaseline_IsDone())
    {
        SensorHealth_Process();
    }
    /* مستقیم از data[] پکت بساز */
    for (uint8_t i = 0; i < 32; i++) {
      pkt.d[i] = clamp_u8(ptrTof_1->data[i]);
    }

    xQueueOverwrite(qSensors, &pkt);

    vTaskDelay(pdMS_TO_TICKS(100));

	#if DBG_BUS_STATUS

			if ((xTaskGetTickCount() - lastPrint) > pdMS_TO_TICKS(1000))
			{
				lastPrint = xTaskGetTickCount();

				printf("BUS EN: I2C1=%u I2C2=%u I2C3=%u I2C4=%u | DATA: ",
					   v_I2C1_Bus,
					   v_I2C2_Bus,
					   v_I2C3_Bus,
					   v_I2C4_Bus);

				for (int i = 0; i < 8; i++) {
					printf("%u ", pkt.d[i]);
				}

				printf("\r\n");
			}

	#endif
  }
}

void CmdTask(void *argument)
{
  const uint8_t BOARD_ID = 1;
  CAN_Frame_t f;

  for (;;)
  {
    if (xQueueReceive(canRxQueue, &f, portMAX_DELAY) == pdPASS)
    {
     // HAL_GPIO_TogglePin(LED7_GPIO_Port, LED7_Pin);

      // اگر خواستی چاپ هم بکن
    	CAN_RX_LOG("id=0x%03lX dlc=%u flags=0x%02X data=%02X %02X %02X %02X %02X %02X %02X %02X",
    	           f.id,
    	           f.dlc,
    	           f.flags,
    	           f.data[0], f.data[1], f.data[2], f.data[3],
    	           f.data[4], f.data[5], f.data[6], f.data[7]);

    	/* Generic node commands:
    	 *   0x300 + BOARD_ID
    	 *
    	 * NOTE:
    	 * Currently no generic node dispatcher is connected here.
    	 * Keep this ID range reserved for future node-level commands.
    	 */
    	uint32_t rx_id = f.id; // Keep a local copy of received CAN ID for routing.
    	// NOTE: Motor commands and generic node commands use separate CAN ID ranges.
    	if (rx_id == (CMD_BASE_ID + BOARD_ID))
    	{
    	    // node_cmd_dispatch(&f, BOARD_ID);
    	}

    	/* Motor commands:
    	 *   0x400 + BOARD_ID
    	 *
    	 * These are dispatched to motor command parser.
    	 */
    	else if (rx_id == (MOTOR_CMD_BASE_ID + BOARD_ID))
    	{

    	    motor_cmd_dispatch(&f, BOARD_ID);
    	}
    }
  }
}

void CanTxTask(void *argument)
{
  for(;;)
  {
    osDelay(1);
  }
}

/* USER CODE BEGIN Application */
/*void DebugTask(void *argument)
{

    while(1)
    {
        HAL_GPIO_TogglePin(LED2_GPIO_Port, LED2_Pin);

	#if DBG_HEALTH

		if (SensorBaseline_IsDone())
		{
			const sensor_baseline_data_t *b = SensorBaseline_GetData();

			// گرفتن health فعلی سنسورها
			// NOTE: فقط برای دیباگ چاپ استفاده می‌شود
			const sensor_health_t *h = SensorHealth_GetAll();

			printf("HEALTH:\r\n");

			// چاپ سلامت فقط برای سنسورهایی که baseline معتبر دارند
			// NOTE: سنسورهای وصل‌نشده یا بدون baseline چاپ نمی‌شوند
			for (int i = 0; i < 32; i++)
			{
				if (b->valid[i])
				{
					printf("H[%02d] valid=%u load=%u noisy=%u no_upd=%u stuck=%u fault=%u\r\n",
						   i,
						   h[i].is_valid,
						   h[i].is_loaded,
						   h[i].is_noisy,
						   h[i].is_no_update,
						   h[i].is_stuck,
						   h[i].fault);
				}
			}

		}

	#endif

		#if DBG_MOTOR_TEST
			static uint8_t motor_test_started = 0;

			if (!motor_test_started)
			{
				motor_test_started = 1;

				// تست حرکت موتور 0 به position=200 step
				// NOTE:
				// این فقط برای تست اولیه MotorControl است.
				// بعد از تست، DBG_MOTOR_TEST را صفر کن.
				printf("MOTOR TEST: motor 0 -> pos 200\r\n");
				Motor_SetTarget(0, 200);
			}

			const actuator_t *m = Motor_Get(0);

			printf("M0 pos=%d target=%d moving=%u fault=%u rem=%ld\r\n",
				   m->current_pos,
				   m->target_pos,
				   m->is_moving,
				   m->fault,
				   (long)stepper_remaining(0));
		#endif

        vTaskDelay(pdMS_TO_TICKS(500));
    }

}*/

void DebugTask(void *argument)
{

    while (1)
    {

        vTaskDelay(pdMS_TO_TICKS(1000));
    }
}
/*----------------------------------------------------------------------------*/

/* USER CODE END Application */
